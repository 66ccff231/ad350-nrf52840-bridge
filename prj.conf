## CMakeLists.txt
```
# 功率计 BLE 桥接固件（nRF52840 / Zephyr）
#
# 把功率计的私有测量数据转成标准 BLE Cycling Power 服务（0x1818）广播出去，
# 让手机 app / 码表当作普通蓝牙功率计来连接。
#
# 为什么不用 ANT+：本板没有 SWD 编程器，而 ANT SoftDevice 会覆盖 UF2 引导器；
# 且 ANT+ 需 Garmin 授权、SoftDevice 许可也限制用途。走 BLE 完全绕开这些。

cmake_minimum_required(VERSION 3.20.0)

find_package(Zephyr REQUIRED HINTS $ENV{ZEPHYR_BASE})
project(ble_power_bridge)

target_sources(app PRIVATE
    src/main.c
    src/meter_protocol.c
)
```

## west.yml
```
# West 清单：把本仓库声明为一个 Zephyr 应用仓库
#
# 作用：让 `west init -m <本仓库>` 能自动拉取 Zephyr 源码与全部依赖模块。
# 没有这个文件，CI 里的 `west init` 会直接失败（这是第一次构建失败的原因）。
#
# 工作区布局（west init -m 之后）：
#   <workspace>/app      <- 本仓库
#   <workspace>/zephyr   <- Zephyr 内核
#   <workspace>/modules  <- 各依赖模块
#
# 版本选择：v4.1.0 是稳定发行版，且已确认其中的
#   boards/others/promicro_nrf52840 提供 nrf52840/uf2 构建目标。

manifest:
  self:
    path: app

  remotes:
    - name: zephyrproject-rtos
      url-base: https://github.com/zephyrproject-rtos

  projects:
    - name: zephyr
      remote: zephyrproject-rtos
      revision: v4.1.0
      import: true
```

## prj.conf
```kconfig
# 功率计 BLE 桥接 —— Zephyr 配置
# 目标：nRF52840，同时做 BLE Central（连功率计）和 Peripheral（对外冒充功率计）

# --- 蓝牙基础 ---
CONFIG_BT=y
CONFIG_BT_PERIPHERAL=y
CONFIG_BT_CENTRAL=y
CONFIG_BT_OBSERVER=y          # 需要扫描功率计
CONFIG_BT_GATT_CLIENT=y       # 需要订阅功率计的 0x2A63

# 状态指示灯（板载 LED0 = P0.15）
CONFIG_GPIO=y

# bt_gatt_service_register()（运行时注册服务）在较新 Zephyr 里
# 属于动态 GATT 数据库特性，不开启会链接失败：
#   undefined reference to `bt_gatt_service_register'
CONFIG_BT_GATT_DYNAMIC_DB=y

# 一个到功率计的连接（Central）+ 一个码表连接（Peripheral），留点余量
CONFIG_BT_MAX_CONN=4
CONFIG_BT_MAX_PAIRED=2

# --- 配对支持 ---
# 之前完全没开 SMP，手机发起配对时设备回「不支持配对」，
# 系统蓝牙显示「拒绝配对」；不少运动 app 只列出能配对的设备，
# 所以这很可能也是行者 app 搜不到的原因之一。
# 说明：未启用 CONFIG_BT_SETTINGS，配对密钥只保存在内存里，
# 断电后需要重新配对；对「一路骑行期间保持供电」的用法够用。
CONFIG_BT_SMP=y
CONFIG_BT_BONDABLE=y
CONFIG_BT_KEYS_OVERWRITE_OLDEST=y

# 设备名（也会写进扫描响应）。必须与 src/main.c 的 DEVICE_NAME 一致。
CONFIG_BT_DEVICE_NAME="Power Meter Bridge"

# GAP Appearance = 0x0484 = "Cycling: Power Sensor"
# 很多运动 app 按 Appearance 筛选功率计，不设置就可能搜不到本机。
# 0x0484 = 1156（十进制）
CONFIG_BT_DEVICE_APPEARANCE=1156

# --- 日志 ---
CONFIG_LOG=y
CONFIG_LOG_MODE_DEFERRED=y
CONFIG_LOG_DEFAULT_LEVEL=3

# --- USB CDC ACM 控制台 ---
# 板子的 usbd 已启用（见板级 DTS），把 console 与日志接到 USB 虚拟串口，
# 这样同一根 USB 线既能供电/烧录，也能看日志。见同名 overlay 文件。
CONFIG_USB_DEVICE_STACK=y
CONFIG_USB_DEVICE_INITIALIZE_AT_BOOT=y
CONFIG_USB_CDC_ACM=y
CONFIG_UART_CONSOLE=y
CONFIG_UART_INTERRUPT_DRIVEN=y
CONFIG_LOG_BACKEND_UART=y

# --- 内存 ---
CONFIG_HEAP_MEM_POOL_SIZE=8192
CONFIG_MAIN_STACK_SIZE=4096
CONFIG_SYSTEM_WORKQUEUE_STACK_SIZE=4096
CONFIG_BT_BUF_ACL_RX_SIZE=251
CONFIG_BT_BUF_ACL_TX_SIZE=251
```

## promicro_nrf52840_nrf52840_uf2.overlay
```dts
/*
 * ProMicro nRF52840 板级补充：把控制台/日志改到 USB CDC ACM
 *
 * 为什么要这个：
 *   这块板子的 USB 由 nice!nano 类引导器提供，应用本身没有串口输出，
 *   所以脱离电脑和串口工具就看不清固件在干什么。
 *   板子的 DTS 里 `zephyr_udc0: &usbd { status = "okay"; }`，USB 设备控制器可用，
 *   于是加一个 CDC ACM 虚拟串口，把 console 与日志都接到它上：
 *   同一根 USB 线，既能供电/烧录，又能用串口工具看日志。
 *
 * 用法：插上 USB 后，设备管理器里会出现一个 COM 口（波特率随便填，CDC 不限速）。
 */

/ {
	chosen {
		zephyr,console = &cdc_acm_uart0;
		zephyr,shell-uart = &cdc_acm_uart0;
	};
};

&zephyr_udc0 {
	cdc_acm_uart0: cdc_acm_uart0 {
		compatible = "zephyr,cdc-acm-uart";
	};
};
```

## src/meter_protocol.c
```c
/*
 * 功率计私有帧解析实现 —— 游标式
 *
 * 用一个读游标按线序依次取字段。关键在于游标是「粘性失败」的：
 * 一旦某次读取越界，游标即被毒化，后续读取一律失败。
 *
 * 这样帧被截短时，尾部那些根本没出现的字段自然保持为 0，
 * 调用处不必在每个字段上都重复一遍长度判断 —— 长度只在游标里处理一次。
 */

#include "meter_protocol.h"

/** @brief 帧内读游标；left 表示还剩多少字节可读，为 0 表示已毒化 */
typedef struct
{
    uint8_t const *at;
    size_t         left;
} cursor_t;

static bool take_u8(cursor_t *c, uint8_t *out)
{
    if (c->left < 1U)
    {
        c->left = 0U;   /* 毒化：之后的读取不会再成功 */
        return false;
    }

    *out = c->at[0];

    c->at   += 1;
    c->left -= 1U;

    return true;
}

static bool take_u16(cursor_t *c, uint16_t *out)
{
    if (c->left < 2U)
    {
        c->left = 0U;   /* 毒化 */
        return false;
    }

    *out = (uint16_t)((uint16_t)c->at[0] | ((uint16_t)c->at[1] << 8));

    c->at   += 2;
    c->left -= 2U;

    return true;
}

static bool take_s16(cursor_t *c, int16_t *out)
{
    uint16_t raw;

    if (!take_u16(c, &raw))
    {
        return false;
    }

    *out = (int16_t)raw;

    return true;
}

bool meter_frame_parse(uint8_t const *payload, size_t length, meter_frame_t *out)
{
    if ((payload == NULL) || (out == NULL) || (length < 2U))
    {
        return false;
    }

    *out = (meter_frame_t){0};

    cursor_t c = {.at = payload, .left = length};

    uint16_t u16 = 0U;
    int16_t  s16 = 0;
    uint8_t  u8  = 0U;

    /* 上面的长度检查已保证至少 2 字节，这一步必定成功 */
    (void)take_u16(&c, &u16);
    out->total_w = u16;

    if (take_s16(&c, &s16))
    {
        out->left_w = s16;
    }

    if (take_s16(&c, &s16))
    {
        out->right_w = s16;
    }

    if (take_s16(&c, &s16))
    {
        /* 反踩时该字段为负。负值并不代表「很高的踏频」，一律归零。 */
        out->rpm = (s16 > 0) ? (uint16_t)s16 : 0U;
    }

    if (take_u16(&c, &u16))
    {
        out->crank_angle = (int16_t)u16;
    }

    if (take_u8(&c, &u8))
    {
        out->fault = u8;
    }

    return true;
}
```

## src/meter_protocol.h
```c
/*
 * 功率计私有帧解析
 * =================
 *
 * 本文件按协议事实独立实现，不含任何第三方源码。字段偏移属于实现互操作
 * 所必需的功能性信息。
 *
 * 帧布局（实测通知固定 11 字节，小端序）：
 *
 *   偏移  宽度  类型   含义
 *   ----  ----  -----  ------------------------------
 *     0     2   u16    总功率，瓦特
 *     2     2   s16    左侧功率，瓦特
 *     4     2   s16    右侧功率，瓦特
 *     6     2   s16    踏频，rpm（反踩时为负）
 *     8     2   u16    曲柄角度，度（0~359 循环）
 *    10     1   u8     错误码
 *
 * 实测佐证：
 *   - 偏移 6-7 取 0x28 / 0x34 / 0x48 时分别对应 40 / 52 / 72 rpm
 *   - 偏移 8-9 在 0~339 之间循环，与曲柄旋转吻合
 *   - 每帧都满足「总功率 = 左 + 右」
 *
 * BLE 通知的长度并不保证恰好 11 字节，所以解析按顺序推进；帧被截短时，
 * 尾部读不到的字段保持 0。
 */

#ifndef METER_PROTOCOL_H__
#define METER_PROTOCOL_H__

#include <stdbool.h>
#include <stddef.h>
#include <stdint.h>

/** @brief 一帧功率计私有数据的解析结果 */
typedef struct
{
    uint16_t total_w;      /**< 总功率（W） */
    int16_t  left_w;       /**< 左侧功率（W） */
    int16_t  right_w;      /**< 右侧功率（W） */
    uint16_t rpm;          /**< 踏频（rpm）；反踩的负值按 0 处理 */
    int16_t  crank_angle;  /**< 曲柄角度（度） */
    uint8_t  fault;        /**< 错误码 */
} meter_frame_t;

/**
 * @brief 解析一帧私有功率数据
 *
 * @param payload 原始通知负载
 * @param length  负载字节数
 * @param out     解析结果；仅在返回 true 时被写入
 *
 * @retval true  至少解析出总功率（长度 >= 2）
 * @retval false 指针为空或长度不足
 */
bool meter_frame_parse(uint8_t const *payload, size_t length, meter_frame_t *out);

#endif /* METER_PROTOCOL_H__ */
```

## src/xds_protocol.c
```c
/*
 * XDS 功率测量解析实现
 *
 * 完整复制 xds_forwarding 中 xds_protocol.c 的偏移与符号约定，
 * 保证与已实测数据（踏频、角度）一致。
 */

#include "xds_protocol.h"

static uint16_t read_le_u16(uint8_t const * p, size_t off)
{
    return (uint16_t)p[off] | (uint16_t)((uint16_t)p[off + 1] << 8);
}

static int16_t read_le_s16(uint8_t const * p, size_t off)
{
    return (int16_t)read_le_u16(p, off);
}

bool xds_power_measurement_parse(uint8_t const * p_payload,
                                 size_t          length,
                                 xds_power_measurement_t * p_output)
{
    if ((p_payload == NULL) || (p_output == NULL) || (length < 2U))
    {
        return false;
    }

    *p_output = (xds_power_measurement_t){0};

    p_output->total_power_w = read_le_u16(p_payload, 0U);

    if (length >= 4U)
    {
        p_output->left_power_w = read_le_s16(p_payload, 2U);
    }
    if (length >= 6U)
    {
        p_output->right_power_w = read_le_s16(p_payload, 4U);
    }
    if (length >= 8U)
    {
        /* 偏移 6 是有符号的：反踩时会出现负值，不能当成大踏频 */
        int16_t const cadence = read_le_s16(p_payload, 6U);
        p_output->cadence_rpm = (cadence > 0) ? (uint16_t)cadence : 0U;
    }
    if (length >= 10U)
    {
        p_output->angle_deg = (int16_t)read_le_u16(p_payload, 8U);
    }
    if (length >= 11U)
    {
        p_output->error_code = p_payload[10];
    }

    return true;
}
```

## src/xds_protocol.h
```c
/*
 * XDS 功率计私有数据解析 —— 字段定义与 xds_forwarding（DuoDuoJuZi）保持一致
 *
 * 已用实测数据验证的部分：
 *   - 通知负载长度 = 11 字节（实测 29 条通知全部为 11 字节）
 *   - 偏移 6-7 = 踏频（s16 LE）：实测 0x28→40、0x34→52、0x48→72 rpm，精确吻合
 *   - 偏移 8-9 = 曲柄角度（u16 LE）：实测在 0..339 之间循环，符合曲柄旋转
 *
 * 尚未在真实负载下验证的部分：
 *   - 偏移 0-1（总功率）：实测空转时恒为 0，符合"无扭矩即无功率"的物理预期，
 *     但还没有拿到真实骑行数据来确认量纲（是否为瓦特）
 *   - 偏移 2-3 / 4-5（左右功率）：同上
 *
 * 若日后拿到真实负载数据发现字段不符，只需修改本文件的偏移即可。
 */

#ifndef XDS_PROTOCOL_H__
#define XDS_PROTOCOL_H__

#include <stdbool.h>
#include <stddef.h>
#include <stdint.h>

/** @brief 一帧 XDS 功率测量的解析结果 */
typedef struct
{
    uint16_t total_power_w;   /**< 总功率（W），来自偏移 0 */
    int16_t  left_power_w;    /**< 左功率（W），来自偏移 2 */
    int16_t  right_power_w;   /**< 右功率（W），来自偏移 4 */
    uint16_t cadence_rpm;     /**< 踏频（rpm），来自偏移 6；负值（反踩）归零 */
    int16_t  angle_deg;       /**< 曲柄角度（度），来自偏移 8 */
    uint8_t  error_code;      /**< 错误码，来自偏移 10 */
} xds_power_measurement_t;

/**
 * @brief 解析一帧 XDS 功率测量负载
 *
 * @param p_payload 来自 0x2A63 特征的原始通知负载
 * @param length    负载字节数
 * @param p_output  解析结果
 *
 * @retval true  解析成功（长度至少 2 字节）
 * @retval false 指针为空或长度不足
 */
bool xds_power_measurement_parse(uint8_t const * p_payload,
                                 size_t          length,
                                 xds_power_measurement_t * p_output);

#endif /* XDS_PROTOCOL_H__ */
```
